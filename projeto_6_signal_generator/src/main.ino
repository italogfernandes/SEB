/* UNIVERSIDADE FEDERAL DE UBERLANDIA
   Biomedical Engineering
   Autors: Ítalo G S Fernandes
           Paulo Camargos Silva
           Nathalia Rodrigues
   contact: italogsfernandes@gmail.com
   URLs: https://github.com/italogfernandes/SEB
  Este codigo faz parte da disciplina de sinais e sistemas
  para engenhara biomedica e visa emular um gerador de sinais
  utilizando as portas DAC do Arduino Due
  Tal sinal tambem sera enviado para a interface Serial
  podendo ser visualizado pelo serial plotter.
    Esquema de montagem:
    Arduino - Dispositivo
    DAC0    - Sinal de saida do canal 0
    DAC1    - Sinal de saida do canal 1
    GND     - Ground comum
*/
#define PINODAC DAC0
#define PINOADC A0
#define UART_BAUDRATE 115200

const double ecg_wave[500] = {
  0, 0.00027337, 0.00054675, 0.00082012, 0.0010935, 0.0013669, 0.0016402, 0.0019136, 0.002187, 0.0024604, 0.0027337, 0.0030071, 0.0032805, 0.0035539, 0.0038272, 0.0041006,
0.004374, 0.0046473, 0.0049207, 0.0051941, 0.0054675, 0.0057408, 0.0060142, 0.0062876, 0.006561, 0.0068343, 0.0071077, 0.0073811, 0.0076545, 0.0079278, 0.0082012, 0.0084746,
0.017655, 0.026836, 0.036017, 0.045198, 0.054379, 0.063559, 0.07274, 0.081921, 0.091102, 0.10028, 0.10946, 0.11864, 0.12782, 0.13701, 0.14619, 0.15537,
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0, 0, 0, 0
};

const double sin_wave[500] = {
  0, 0.012591, 0.02518, 0.037766, 0.050345, 0.062916, 0.075477, 0.088027, 0.10056, 0.11308, 0.12558, 0.13806,
0.15052, 0.16296, 0.17537, 0.18775, 0.2001, 0.21243, 0.22471, 0.23696, 0.24918, 0.26135, 0.27348, 0.28557, 0.29762, 0.30962, 0.32156, 0.33346,
0.3453, 0.35709, 0.36883, 0.3805, 0.39212, 0.40367, 0.41515, 0.42658, 0.43793, 0.44922, 0.46043, 0.47157, 0.48264, 0.49363, 0.50454, 0.51537,
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-0.088027, -0.075477, -0.062916, -0.050345, -0.037766, -0.02518, -0.012591, -2.4493e-16
};

//Obs: A forma de onda quadrada, triangular e rampa sera gerada em tempo de execução

//Tipos de ondas possiveis de se selecionar
typedef enum {
  SIN_WAVE,
  SQUARE_WAVE,
  TRIANGLE_WAVE,
  RAMP_WAVE,
  CONST_WAVE,
  ECG_WAVE
} waveforms_t;

/////////////////////////////////////////////////
// Implementacao de um timer atraves do micros //
/////////////////////////////////////////////////
class Timer_t {
  private:
    unsigned long _actual_time;
    unsigned long _waited_time;
    bool _running;
    uint32_t _interval;

  public:
    bool elapsed;

    Timer_t(uint32_t interval = 1000) {
      _interval = interval;
      elapsed = false;
      _actual_time = micros();
      _waited_time = _actual_time + interval;
    }

    void setInterval(uint32_t interval) {
      _interval = interval;
    }

    uint32_t getInterval() {
      return _interval;
    }

    void start() {
      _running = true;
      _actual_time = millis();
      _waited_time = _actual_time + _interval;
    }

    void stop() {
      _running = false;
    }

    void wait_next() {
      elapsed = false;
    }

    void update() {
      _actual_time = micros();
      if (_running) {
        if (_actual_time >= _waited_time) {
          _waited_time = _actual_time + _interval;
          elapsed = true;
        }
      }
    }

};

/////////////////////////////////////////
//Classe para gerar as formas de onda //
////////////////////////////////////////

class SignalGenerator {
private:
  Timer_t _sampling_control;
  waveforms_t _waveform; //Acessible by getter and setter
  uint16_t _actual_index;
  uint8_t _pin_out;
  uint8_t _resolution_bits;
  uint16_t _max_value_resolution;
  double _actual_value;
  double _offset;
  double _amplitude;

  double get_next(){
    switch (_waveform) {
      case SIN_WAVE:
      _actual_value = sin_wave[_actual_index];
      break;
      case SQUARE_WAVE:
      _actual_index > 250? _actual_value = -1: _actual_value = 1;
      break;
      case TRIANGLE_WAVE:
      _actual_value = (double) _actual_index / 250.0;
      if(_actual_value > 1){
        _actual_value = 2 - _actual_value;
      }
      break;
      case RAMP_WAVE:
      _actual_value = (double) _actual_index / 500.0;
      break;
      case CONST_WAVE:
      _actual_value = 1;
      break;
      case ECG_WAVE:
      _actual_value = ecg_wave[_actual_index];
      break;
    }
    _actual_value = _actual_value*_amplitude + _offset;
    //Outro modo
    // _actual_index = _actual_index +1;
    // if(_actual_index >= 500){
    //   _actual_index = 0;
    // }
    ++_actual_index %= 500; //Incremento circular
    return _actual_value;
  }

  void begin() {
    //pinMode(_pin_out, OUTPUT);
    analogWriteResolution(12);
  }

public:
  SignalGenerator (uint8_t pin_out = DAC0,uint8_t resolution_bits = 12){
    _pin_out = pin_out;

    _resolution_bits = resolution_bits;
    _max_value_resolution = pow(2,12) - 1;
    begin();
    _waveform = SIN_WAVE;
    _actual_index = 0;

    _sampling_control.setInterval(1000);
    _offset = 0;
    _amplitude = 100;
  }

  void start(){
    _sampling_control.start();
  }

  void stop(){
    _sampling_control.stop();
  }

  void generate_value(){
    get_next();
    analogWrite(DAC0,(uint16_t) _actual_value);
    analogWrite(DAC1,(uint16_t) _actual_value);
    Serial.println(String((uint16_t) _actual_value));
  }

  void update() {
    _sampling_control.update();
    if (_sampling_control.elapsed) {
      generate_value();
      _sampling_control.wait_next();
    }
  }

  ////////////////////////
  //Getters and Setters //
  ////////////////////////
  void setAquireInterval(uint32_t interval) {
    _sampling_control.setInterval(interval);
  }

  uint32_t getAquireInterval() {
    return _sampling_control.getInterval();
  }

  void setFreq(double frequency) {
    // 500 ticks /s = 1 Hz
    // 500Hz = 1Hz
    // 5000Hz = 10Hz
    // 5000Hz = 0.2ms
    frequency = frequency * 500;
    setAquireInterval((uint32_t) (1000000 / frequency));
  }

  double getFreq() {
    //500 ticks /s = 1 Hz
    return (double) 500*1000000 / (double) getAquireInterval();
  }

  waveforms_t getWaveform(){
    return _waveform;
  }

  void setWaveform(waveforms_t waveform){
    _waveform = waveform;
  }

  void setAmplitude(double amplitude){
    _amplitude = amplitude;
  }

  void setOffset(double offset){
    _offset = offset;
  }
};

//////////////////////
//Variaveis globais //
//////////////////////
const int chaves[] = {2,3,4,5,6,7};
SignalGenerator my_generator; //lazy thing, work around...
bool status_led = false;
char serialOp;
uint8_t seletor;
//////////////////
//Main Function //
//////////////////
void setup() {
  analogWriteResolution(12);
  pinMode(LED_BUILTIN, OUTPUT);
  for(int i = 0; i < 6; i++){
    pinMode(chaves[i], INPUT_PULLUP);
  }
  Serial.begin(UART_BAUDRATE);
  Serial.println("Hora do show! Birl");
  my_generator.setOffset(2048);
  my_generator.setAmplitude(1638);
  my_generator.setWaveform(SIN_WAVE);
  my_generator.setFreq(1); //1Hz
  my_generator.start();
}

void loop() {
  my_generator.setFreq(map(analogRead(PINOADC),0,1023,1,10)); //1Hz
  my_generator.update();
  if(!digitalRead(chaves[0])){
    my_generator.setWaveform(SIN_WAVE);
  } else if(!digitalRead(chaves[1])){
    my_generator.setWaveform(SQUARE_WAVE);
  } else if(!digitalRead(chaves[2])){
    my_generator.setWaveform(TRIANGLE_WAVE);
  } else if(!digitalRead(chaves[3])){
    my_generator.setWaveform(RAMP_WAVE);
  } else if(!digitalRead(chaves[4])){
    my_generator.setWaveform(CONST_WAVE);
  } else if(!digitalRead(chaves[5])){
    my_generator.setWaveform(ECG_WAVE);
  } else {
    my_generator.setWaveform(CONST_WAVE);
  }
}
